## dts/bindings/fuel-gauge/battery_cutoff.yaml
```yaml
#
# Copyright 2023 Google LLC
#
# SPDX-License-Identifier: Apache-2.0
#

compatible: "zephyr,default-battery-cutoff"

description: |

  Note: These properties are to be used with meaningful defaults in fuel gauge ICs that implement
  battery cutoff support. See the fuel gauge SBS Gauge compatible as an example. This yaml file
  serves as working example.

  Binding for fuel-gauges that may control battery cutoff, this is common in SBS compliant or
  similarly smart battery fuel gauges.

properties:
  battery_cutoff_support:
    description: |
      Simple helper prop that indicates this fuel-gauge device can cutoff the battery, this is also
      often called ship or sleep mode. Any non-zero value means battery cutoff is supported.
    type: int
  battery_cutoff_reg_addr:
    description: |
       Address of register responsible to cutoff battery.
    type: int
    default: 0x00
  battery_cutoff_payload:
    description: |
       Payload to write to cutoff battery. NOTE: This may contain a duplicate value as some ICs
       require writing to the cutoff register twice.
    type: array
    default: [0x0010, 0x0010]
```

## dts/bindings/fuel-gauge/lgc,ap19b8m.yaml
```yaml
#
# Copyright 2023 Google LLC
#
# SPDX-License-Identifier: Apache-2.0
#

include: ["sbs,sbs-gauge-new-api.yaml"]

compatible: "lgc,ap19b8m"

properties:
  # Battery cutoff properties.
  battery_cutoff_support:
    default: 1
  cutoff_reg_addr:
    default: 0x3A
  cutoff_payload:
    default: [0xC574, 0xC574]
```
